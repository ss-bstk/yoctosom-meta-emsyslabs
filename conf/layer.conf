## conf/layer.conf
```bitbake
# We have a conf and classes directory, add to BBPATH
BBPATH .= ":${LAYERDIR}"

# We have recipes-* directories, add to BBFILES
BBFILES += "${LAYERDIR}/recipes-*/*/*.bb \
            ${LAYERDIR}/recipes-*/*/*.bbappend"

BBFILE_COLLECTIONS += "meta-emsyslabs"
BBFILE_PATTERN_meta-emsyslabs = "^${LAYERDIR}/"
BBFILE_PRIORITY_meta-emsyslabs = "10"

PACKAGECONFIG:append:pn-libcamera = " gst"

LAYERDEPENDS_meta-emsyslabs = "core meta-somlabs"
LAYERSERIES_COMPAT_meta-emsyslabs = "scarthgap"
```
